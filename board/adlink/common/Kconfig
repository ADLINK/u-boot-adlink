## board/adlink/common/Kconfig
```kconfig
if !ARCH_IMX8M && !ARCH_IMX8

config USB_TCPC
	bool "USB Typec port controller simple driver"
	default n
	help
	  Enable USB type-c port controller (TCPC) driver

endif
```

## board/adlink/lec-imx8m/Kconfig
```kconfig
if TARGET_LEC_IMX8MQ

config SYS_BOARD
	default "lec-imx8m"

config SYS_VENDOR
	default "adlink"

config SYS_CONFIG_NAME
	default "lec-imx8m"

config CONFIG_IMX_DDRSIZE
	bool "Define lec-imx8m DDR Size"
	depends on TARGET_LEC_IMX8MQ || TARGET_LEC_IMX8MP

choice
	prompt "Select a lec-imx8m DDR Size"
	depends on CONFIG_IMX_DDRSIZE

	config DDR3L_1GB
		bool "DDR3L_1GB"

	config DDR3L_2GB
		bool "DDR3L_2GB"

	config DDR3L_4GB
		bool "DDR3L_4GB"

	config DDR3L_4GB_MT
		bool "DDR3L_4GB_MT"

endchoice

source "board/adlink/common/Kconfig"

endif
```

## board/adlink/lec-imx8mm/Kconfig
```kconfig
if TARGET_LEC_IMX8MM

config SYS_BOARD
	default "lec-imx8mm"

config SYS_VENDOR
	default "adlink"

config SYS_CONFIG_NAME
	default "lec-imx8mm"

source "board/adlink/common/Kconfig"

endif
```

## board/adlink/lec-imx8mp/Kconfig
```kconfig
if TARGET_LEC_IMX8MP

config SYS_BOARD
	default "lec-imx8mp"

config SYS_VENDOR
	default "adlink"

config SYS_CONFIG_NAME
	default "lec-imx8mp"

config CONFIG_IMX_DDRSIZE
	bool "Define lec-imx8mp DDR Size"
	depends on TARGET_LEC_IMX8MP

choice
	prompt "Select a lec-imx8mp DDR Size"
	depends on CONFIG_IMX_DDRSIZE

	config LPDDR4_2GB
		bool "LPDDR4_2GB"

        config LPDDR4_2GK
		bool "LPDDR4_2GK"

	config LPDDR4_4GB
		bool "LPDDR4_4GB"

endchoice

source "board/adlink/common/Kconfig"

endif
```
